## asus-layers/meta-apt-ubuntu/conf/layer.conf
```bitbake
# We have a conf and classes directory, add to BBPATH
BBPATH .= ":${LAYERDIR}"

# We have recipes-* directories, add to BBFILES
BBFILES += "${LAYERDIR}/recipes-*/*/*.bb \
            ${LAYERDIR}/recipes-*/*/*.bbappend"

BBFILE_COLLECTIONS += "apt-ubuntu"
BBFILE_PATTERN_apt-ubuntu = "^${LAYERDIR}/"
BBFILE_PRIORITY_apt-ubuntu = "6"

LAYERDEPENDS_apt-ubuntu = "core"
LAYERSERIES_COMPAT_apt-ubuntu = "scarthgap"
```

## asus-layers/meta-asus/conf/layer.conf
```bitbake
# We have a conf and classes directory, add to BBPATH
BBPATH .= ":${LAYERDIR}"

# We have recipes-* directories, add to BBFILES
BBFILES += "${LAYERDIR}/recipes-*/*/*.bb \
            ${LAYERDIR}/recipes-*/*/*.bbappend"

BBFILE_COLLECTIONS += "meta-asus"
BBFILE_PATTERN_meta-asus = "^${LAYERDIR}/"

# This layer has a priority of 10, higher than the default, make sure overrides others
BBFILE_PRIORITY_meta-asus = "10"

LAYERDEPENDS_meta-asus = "core"
LAYERSERIES_COMPAT_meta-asus = "scarthgap"
```

## build-qemuarm64/conf/bblayers.conf
```bitbake
# POKY_BBLAYERS_CONF_VERSION is increased each time build/conf/bblayers.conf
# changes incompatibly
POKY_BBLAYERS_CONF_VERSION = "2"

WORKSPACE := "${@os.path.abspath(os.path.dirname(d.getVar('FILE', True)))}/../.."

BBPATH = "${TOPDIR}"
BBFILES ?= ""

BBLAYERS ?= " \
  ${WORKSPACE}/layers/poky/meta \
  ${WORKSPACE}/layers/poky/meta-poky \
  ${WORKSPACE}/layers/poky/meta-yocto-bsp \
  "
```

## meta-myiq9qemu/conf/layer.conf
```bitbake
# We have a conf and classes directory, add to BBPATH
BBPATH .= ":${LAYERDIR}"

# We have recipes-* directories, add to BBFILES
BBFILES += "${LAYERDIR}/recipes-*/*/*.bb \
            ${LAYERDIR}/recipes-*/*/*.bbappend"

BBFILE_COLLECTIONS += "meta-myiq9qemu"
BBFILE_PATTERN_meta-myiq9qemu = "^${LAYERDIR}/"
BBFILE_PRIORITY_meta-myiq9qemu = "6"

LAYERDEPENDS_meta-myiq9qemu = "core"
LAYERSERIES_COMPAT_meta-myiq9qemu = "scarthgap"
```
